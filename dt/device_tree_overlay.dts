/dts-v1/;
/plugin/;

/*
 * El Pinmux (Control Module), Clock (CM_PER) y Power Mode (PWRIDLESYSCONFIG)
 * son gestionados directamente por registros desde el driver td3_i2s.
 */
&mcasp0 {
    compatible = "utn,mcasp-device";
    status = "okay";

    utn,frecuencia = <1000000>;
};
